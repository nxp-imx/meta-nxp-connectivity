## meta-nxp-matter-advanced/conf/machine/imx8mmevk-matter.conf
```bitbake
#@TYPE: Machine
#@NAME: i.MX 8MM Consolidated Machine For Matter
#@DESCRIPTION: A consolidated machine for i.MX 8MM LPDDR4 EVK Matter demos
#@MAINTAINER: Haoran Wang <elven.wang@nxp.com>

MACHINEOVERRIDES =. "imx8mm-lpddr4-evk:"
require conf/machine/imx8mm-lpddr4-evk.conf

MACHINE_FEATURES:remove:use-nxp-bsp = "optee"
MACHINE_FEATURES:append = " trusty "

UBOOT_CONFIG = "trusty"
UBOOT_CONFIG[trusty] = "imx8mm_evk_matter_trusty_defconfig,sdcard"

IMAGE_INSTALL:append = " packagegroup-nxp-matter-baseline packagegroup-nxp-openthread packagegroup-nxp-otbr packagegroup-nxp-zigbee-rcp "

# Include device trees for other boards for internal test
KERNEL_DEVICETREE += " \
    freescale/imx8mm-ddr4-evk.dtb \
    freescale/imx8mm-ddr4-evk-pcie-ep.dtb \
    freescale/imx8mm-ddr4-evk-rm67191.dtb \
    freescale/imx8mm-ddr4-evk-rm67191-cmd-ram.dtb \
    freescale/imx8mm-ddr4-evk-rm67199.dtb \
    freescale/imx8mm-ddr4-evk-rm67199-cmd-ram.dtb \
    freescale/imx8mm-ddr4-evk-revb.dtb \
    freescale/imx8mm-ddr4-evk-revb-rm67191.dtb \
    freescale/imx8mm-ddr4-evk-revb-rm67191-cmd-ram.dtb \
    freescale/imx8mm-ddr4-evk-revb-rm67199.dtb \
    freescale/imx8mm-ddr4-evk-revb-rm67199-cmd-ram.dtb \
    freescale/imx8mm-evk-usd-wifi-uart3-bt-3000000-ffu-gpio-irq.dtb \
    freescale/imx8mm-evk-usd-wifi-uart3-bt-115200-ffu-gpio-irq.dtb \
    freescale/imx8mm-evk-usd-wifi-uart3-bt-IW610-3000000-ffu-gpio-irq.dtb \
    freescale/imx8mm-evk-usd-wifi-uart3-bt-IW610-115200-ffu-gpio-irq.dtb \
    freescale/imx8mmevk-ncp-host.dtb \
    freescale/imx8mmevk-ncp-host-uart.dtb \
"
DTS_FILE = " \
    ${BSPDIR}/sources/meta-nxp-connectivity/meta-nxp-otbr/recipes-kernel/linux/files/dts/imx8mm-evk-usd-wifi-uart3-bt-3000000-ffu-gpio-irq.dts \
    ${BSPDIR}/sources/meta-nxp-connectivity/meta-nxp-otbr/recipes-kernel/linux/files/dts/imx8mm-evk-usd-wifi-uart3-bt-115200-ffu-gpio-irq.dts \
    ${BSPDIR}/sources/meta-nxp-connectivity/meta-nxp-otbr/recipes-kernel/linux/files/dts/imx8mm-evk-usd-wifi-uart3-bt-IW610-3000000-ffu-gpio-irq.dts \
    ${BSPDIR}/sources/meta-nxp-connectivity/meta-nxp-otbr/recipes-kernel/linux/files/dts/imx8mm-evk-usd-wifi-uart3-bt-IW610-115200-ffu-gpio-irq.dts \
    ${BSPDIR}/sources/meta-nxp-connectivity/meta-nxp-otbr/recipes-kernel/linux/files/dts/imx8mmevk-ncp-host.dts \
    ${BSPDIR}/sources/meta-nxp-connectivity/meta-nxp-otbr/recipes-kernel/linux/files/dts/imx8mmevk-ncp-host-uart.dts \
"

UBOOT_DELTA_CONFIG = "${UNPACKDIR}/uboot-config/*"

DISTRO_FEATURES:remove = "ptest"

# Indicates the machine supports IWxxx modules
MACHINE_FEATURES += "has-iwxxx"

# Indicates the machine supports Matter NCP modules
MACHINE_FEATURES += "has-matter-ncp"
```

## meta-nxp-matter-advanced/conf/machine/imx8mnddr3levk-matter.conf
```bitbake
#@TYPE: Machine
#@NAME: i.MX 8MN Consolidated Machine For Matter
#@DESCRIPTION: A consolidated machine for i.MX 8MN DDR3L EVK Matter demos
#@MAINTAINER: Haoran Wang <elven.wang@nxp.com>
#Machine is renamed from imx8mnul-ddr3l-evk

MACHINEOVERRIDES =. "imx8mnul-ddr3l-evk:"
require conf/machine/imx8mnul-ddr3l-evk.conf

KERNEL_DEVICETREE += " \
    freescale/imx8mn-ddr3l-evk-usd-wifi-uart3-bt-3000000-ffu-gpio-irq.dtb \
    freescale/imx8mn-ddr3l-evk-usd-wifi-uart3-bt-115200-ffu-gpio-irq.dtb \
    freescale/imx8mn-ddr3l-evk-usd-wifi-uart3-bt-IW610-3000000-ffu-gpio-irq.dtb \
    freescale/imx8mn-ddr3l-evk-usd-wifi-uart3-bt-IW610-115200-ffu-gpio-irq.dtb \
"
IMAGE_INSTALL:append = " packagegroup-nxp-matter-baseline packagegroup-nxp-openthread packagegroup-nxp-otbr packagegroup-nxp-zigbee-rcp "

DTS_FILE = "${BSPDIR}/sources/meta-nxp-connectivity/meta-nxp-otbr/recipes-kernel/linux/files/dts/imx8mn-ddr3l-evk-usd-wifi-uart3-bt-3000000-ffu-gpio-irq.dts ${BSPDIR}/sources/meta-nxp-connectivity/meta-nxp-otbr/recipes-kernel/linux/files/dts/imx8mn-ddr3l-evk-usd-wifi-uart3-bt-115200-ffu-gpio-irq.dts ${BSPDIR}/sources/meta-nxp-connectivity/meta-nxp-otbr/recipes-kernel/linux/files/dts/imx8mn-ddr3l-evk-usd-wifi-uart3-bt-IW610-3000000-ffu-gpio-irq.dts ${BSPDIR}/sources/meta-nxp-connectivity/meta-nxp-otbr/recipes-kernel/linux/files/dts/imx8mn-ddr3l-evk-usd-wifi-uart3-bt-IW610-115200-ffu-gpio-irq.dts"

UBOOT_DELTA_CONFIG = "${UNPACKDIR}/uboot-config/*"

# Indicates the machine supports IWxxx modules
MACHINE_FEATURES += "has-iwxxx"
```

## meta-nxp-matter-advanced/conf/machine/imx8mnevk-matter.conf
```bitbake
#@TYPE: Machine
#@NAME: i.MX 8MN Consolidated Machine For Matter
#@DESCRIPTION: A consolidated machine for i.MX 8MN LPDDR4 EVK Matter demos
#@MAINTAINER: Haoran Wang <elven.wang@nxp.com>

MACHINEOVERRIDES =. "imx8mn-lpddr4-evk:"
require conf/machine/imx8mn-lpddr4-evk.conf

IMAGE_INSTALL:append = " packagegroup-nxp-matter-baseline packagegroup-nxp-openthread packagegroup-nxp-otbr packagegroup-nxp-zigbee-rcp "

# Include device trees for other boards for internal test
KERNEL_DEVICETREE += " \
    freescale/imx8mn-ddr4-evk.dtb \
    freescale/imx8mn-ddr4-evk-ak5558.dtb \
    freescale/imx8mn-ddr4-evk-lk.dtb \
    freescale/imx8mn-ddr4-evk-rm67191.dtb \
    freescale/imx8mn-ddr4-evk-rm67191-cmd-ram.dtb \
    freescale/imx8mn-ddr4-evk-rm67199.dtb \
    freescale/imx8mn-ddr4-evk-rm67199-cmd-ram.dtb \
    freescale/imx8mn-ddr4-evk-rpmsg.dtb \
    freescale/imx8mn-ddr4-evk-usd-wifi.dtb \
    freescale/imx8mn-ddr3l-evk.dtb \
    freescale/imx8mn-ddr3l-evk-ak5558.dtb \
    freescale/imx8mn-ddr3l-evk-rpmsg.dtb \
    freescale/imx8mn-lpddr4-evk-usd-wifi-uart3-bt-3000000-ffu-gpio-irq.dtb \
    freescale/imx8mn-lpddr4-evk-usd-wifi-uart3-bt-115200-ffu-gpio-irq.dtb \
    freescale/imx8mn-lpddr4-evk-usd-wifi-uart3-bt-IW610-3000000-ffu-gpio-irq.dtb \
    freescale/imx8mn-lpddr4-evk-usd-wifi-uart3-bt-IW610-115200-ffu-gpio-irq.dtb \
"

DTS_FILE = "${BSPDIR}/sources/meta-nxp-connectivity/meta-nxp-otbr/recipes-kernel/linux/files/dts/imx8mn-lpddr4-evk-usd-wifi-uart3-bt-3000000-ffu-gpio-irq.dts ${BSPDIR}/sources/meta-nxp-connectivity/meta-nxp-otbr/recipes-kernel/linux/files/dts/imx8mn-lpddr4-evk-usd-wifi-uart3-bt-115200-ffu-gpio-irq.dts ${BSPDIR}/sources/meta-nxp-connectivity/meta-nxp-otbr/recipes-kernel/linux/files/dts/imx8mn-lpddr4-evk-usd-wifi-uart3-bt-IW610-3000000-ffu-gpio-irq.dts ${BSPDIR}/sources/meta-nxp-connectivity/meta-nxp-otbr/recipes-kernel/linux/files/dts/imx8mn-lpddr4-evk-usd-wifi-uart3-bt-IW610-115200-ffu-gpio-irq.dts"

UBOOT_DELTA_CONFIG = "${UNPACKDIR}/uboot-config/*"

# Indicates the machine supports IWxxx modules
MACHINE_FEATURES += "has-iwxxx"
```

## meta-nxp-matter-advanced/conf/machine/imx8mpevk-matter.conf
```bitbake
#@TYPE: Machine
#@NAME: i.MX 8MP Consolidated Machine For Matter
#@DESCRIPTION: A consolidated machine for i.MX 8MP LPDDR4 EVK Matter demos
#@MAINTAINER: Haoran Wang <elven.wang@nxp.com>

MACHINEOVERRIDES =. "imx8mp-lpddr4-evk:"
require conf/machine/imx8mp-lpddr4-evk.conf

# Include device trees for other boards for internal test
KERNEL_DEVICETREE += " \
    freescale/imx8mp-ddr4-evk.dtb \
    freescale/imx8mp-navq.dtb \
    freescale/imx8mp-navq-ov5640-ov5645.dtb \
    freescale/imx8mp-navq-ov5647-ov5640.dtb \
    freescale/imx8mp-evk-uart3-bt-3000000-ffu-gpio-irq.dtb \
    freescale/imx8mp-evk-uart3-bt-115200-ffu-gpio-irq.dtb \
    freescale/imx8mp-evk-uart3-bt-IW610-3000000-ffu-gpio-irq.dtb \
    freescale/imx8mp-evk-uart3-bt-IW610-115200-ffu-gpio-irq.dtb \
"
MACHINE_FEATURES:remove:use-nxp-bsp = "optee"
MACHINE_FEATURES:append = " trusty "

UBOOT_CONFIG = "trusty"
UBOOT_CONFIG[trusty] = "imx8mp_evk_matter_trusty_defconfig,sdcard"

IMAGE_INSTALL:append = " packagegroup-nxp-matter-baseline packagegroup-nxp-openthread packagegroup-nxp-otbr packagegroup-nxp-zigbee-rcp "

DTS_FILE = "${BSPDIR}/sources/meta-nxp-connectivity/meta-nxp-otbr/recipes-kernel/linux/files/dts/imx8mp-evk-uart3-bt-3000000-ffu-gpio-irq.dts ${BSPDIR}/sources/meta-nxp-connectivity/meta-nxp-otbr/recipes-kernel/linux/files/dts/imx8mp-evk-uart3-bt-115200-ffu-gpio-irq.dts ${BSPDIR}/sources/meta-nxp-connectivity/meta-nxp-otbr/recipes-kernel/linux/files/dts/imx8mp-evk-uart3-bt-IW610-3000000-ffu-gpio-irq.dts ${BSPDIR}/sources/meta-nxp-connectivity/meta-nxp-otbr/recipes-kernel/linux/files/dts/imx8mp-evk-uart3-bt-IW610-115200-ffu-gpio-irq.dts"

UBOOT_DELTA_CONFIG = "${UNPACKDIR}/uboot-config/*"

# Indicates the machine supports IWxxx modules
MACHINE_FEATURES += "has-iwxxx"
```

## meta-nxp-matter-advanced/conf/machine/imx8ulpevk-matter.conf
```bitbake
#@TYPE: Machine
#@NAME: i.MX8ULP EVK Matter
#@SOC: i.MX8ULP
#@MAINTAINER: Haoran Wang <elven.wang@nxp.com>

require conf/machine/imx8ulpevk.conf

UBOOT_DELTA_CONFIG = "${UNPACKDIR}/uboot-config/*"

IMAGE_INSTALL:append = " packagegroup-nxp-matter-baseline packagegroup-nxp-openthread packagegroup-nxp-otbr packagegroup-nxp-zigbee-rcp docker-moby "

# Set to true to enable EdgeLock Enclave
USE_ELE = "true"
```
