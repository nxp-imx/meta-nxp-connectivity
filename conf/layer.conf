## conf/layer.conf
```bitbake
BBPATH .= ":${LAYERDIR}"

BBFILES += "${LAYERDIR}/recipes-*/*/*.bb \
            ${LAYERDIR}/recipes-*/*/*.bbappend"

BBFILE_PATTERN_otbr:= "^${LAYERDIR}/"
BBFILE_PRIORITY_otbr= "7"

BBFILE_COLLECTIONS += "meta-matter"
BBFILE_PATTERN_meta-matter := "^${LAYERDIR}/"
BBFILE_PRIORITY_meta-matter = "8"
LAYERSERIES_COMPAT_meta-matter = "langdale mickledore"

IMAGE_INSTALL:append = " jsoncpp otbr matter openthread tayga dcldownloader ${@bb.utils.contains('MACHINE_FEATURES', 'trusty', 'storageproxyd', '', d)} "

IMAGE_INSTALL:append = "${@bb.utils.contains_any('MULTILIBS', "multilib:lib32", " lib32-glibc lib32-libgcc lib32-libstdc++ zbcoord ", '', d)} "

HOSTTOOLS += " npm node python3 python "

TOOLCHAIN_HOST_TASK:append=" nativesdk-protobuf-compiler"
```

## conf/machine/imx8mmevk-iw612-matter.conf
```bitbake
#@TYPE: Machine
#@NAME: i.MX 8MM Consolidated Machine
#@DESCRIPTION: A consolidated IW612 MATTER machine for i.MX 8MM LPDDR4 and DDR4 EVK
#@MAINTAINER: Jean-Yves Salaün <jean-yves.salaun@nxp.com>

MACHINEOVERRIDES =. "imx8mm-lpddr4-evk:"
require conf/machine/imx8mm-lpddr4-evk.conf

DELTA_KERNEL_DEFCONFIG="${WORKDIR}/WCS-kernel-config/*"
# Include device trees for other boards for internal test
KERNEL_DEVICETREE += " \
    freescale/imx8mm-evk-iw612-otbr.dtb \
"
DTS_FILE="${BSPDIR}/sources/meta-matter/recipes-kernel/linux/files/imx8mm-evk-iw612-otbr.dts"

UBOOT_DELTA_CONFIG="${WORKDIR}/WCS-uboot-config/*"
```

## conf/machine/imx8mmevk-matter.conf
```bitbake
#@TYPE: Machine
#@NAME: i.MX 8MM Consolidated Machine For Matter
#@DESCRIPTION: A consolidated machine for i.MX 8MM LPDDR4 EVK Matter demos
#@MAINTAINER: Haoran Wang <elven.wang@nxp.com>

MACHINEOVERRIDES =. "imx8mm-lpddr4-evk:"
require conf/machine/imx8mm-lpddr4-evk.conf

MACHINE_FEATURES:remove:use-nxp-bsp = "optee"
MACHINE_FEATURES:append = " trusty "

UBOOT_CONFIG = "trusty"
UBOOT_CONFIG[trusty] = "imx8mm_evk_matter_trusty_defconfig,sdcard"

# Include device trees for other boards for internal test
KERNEL_DEVICETREE += " \
    freescale/imx8mm-ddr4-evk.dtb \
    freescale/imx8mm-ddr4-evk-pcie-ep.dtb \
    freescale/imx8mm-ddr4-evk-rm67191.dtb \
    freescale/imx8mm-ddr4-evk-rm67191-cmd-ram.dtb \
    freescale/imx8mm-ddr4-evk-rm67199.dtb \
    freescale/imx8mm-ddr4-evk-rm67199-cmd-ram.dtb \
    freescale/imx8mm-ddr4-evk-revb.dtb \
    freescale/imx8mm-ddr4-evk-revb-rm67191.dtb \
    freescale/imx8mm-ddr4-evk-revb-rm67191-cmd-ram.dtb \
    freescale/imx8mm-ddr4-evk-revb-rm67199.dtb \
    freescale/imx8mm-ddr4-evk-revb-rm67199-cmd-ram.dtb \
"
```

## meta-nxp-connectivity-examples/conf/layer.conf
```bitbake
BBPATH .= ":${LAYERDIR}"

BBFILES += "${LAYERDIR}/recipes-*/*/*.bb \
            ${LAYERDIR}/recipes-*/*/*.bbappend"

LAYERSERIES_COMPAT_nxp-connectivity-examples = "styhead walnascar whinlatter wrynose"

IMAGE_INSTALL:append = " zigbee-coordinator matter-ncp "
IMAGE_INSTALL:append = " ${@bb.utils.contains_any('TUNE_FEATURES', 'armv8 armv8a', 'easymesh', '', d)} "

BBFILE_COLLECTIONS += "nxp-connectivity-examples"
BBFILE_PATTERN_nxp-connectivity-examples = "^${LAYERDIR}/"
BBFILE_PRIORITY_nxp-connectivity-examples = "7"
```

## meta-nxp-matter-advanced/conf/layer.conf
```bitbake
BBPATH .= ":${LAYERDIR}"

BBFILES += "${LAYERDIR}/recipes-*/*/*.bb \
            ${LAYERDIR}/recipes-*/*/*.bbappend"

LAYERSERIES_COMPAT_nxp-matter-advanced = "styhead walnascar whinlatter wrynose"

IMAGE_INSTALL:append = " ${@bb.utils.contains('MACHINE_FEATURES', 'trusty', 'storageproxyd', '', d)} "
IMAGE_INSTALL:append = " avahi-utils"

BBFILE_COLLECTIONS += "nxp-matter-advanced"
BBFILE_PATTERN_nxp-matter-advanced = "^${LAYERDIR}/"
BBFILE_PRIORITY_nxp-matter-advanced = "8"
```

## meta-nxp-matter-advanced/conf/machine/imx8mmevk-iw612-matter.conf
```bitbake
#@TYPE: Machine
#@NAME: i.MX 8MM Consolidated Machine
#@DESCRIPTION: A consolidated IW612 MATTER machine for i.MX 8MM LPDDR4 and DDR4 EVK
#@MAINTAINER: Jean-Yves Salaün <jean-yves.salaun@nxp.com>

MACHINEOVERRIDES =. "imx8mm-lpddr4-evk:"
require conf/machine/imx8mm-lpddr4-evk.conf

MACHINE_FEATURES:append = " matteradvanced "

DELTA_KERNEL_DEFCONFIG="${WORKDIR}/WCS-kernel-config/*"
# Include device trees for other boards for internal test
KERNEL_DEVICETREE += " \
    freescale/imx8mm-evk-uart3-bt-ffu-gpio-irq.dtb \
    freescale/imx8mm-evk-uart3-bt-3M-ffu-gpio-irq.dtb \
"
DTS_FILE="${BSPDIR}/sources/meta-matter/recipes-kernel/linux/files/imx8mm-evk-uart3-bt-ffu-gpio-irq.dts ${BSPDIR}/sources/meta-matter/recipes-kernel/linux/files/imx8mm-evk-uart3-bt-3M-ffu-gpio-irq.dts"

UBOOT_DELTA_CONFIG="${WORKDIR}/WCS-uboot-config/*"
```

## meta-nxp-matter-advanced/conf/machine/imx93evk-iw612-matter.conf
```bitbake
#@TYPE: Machine
#@NAME: A consolidated IW612 MATTER machine for i.MX 93 EVK
#@SOC: i.MX93
#@MAINTAINER: Jean-Yves Salaün <jean-yves.salaun@nxp.com>

MACHINEOVERRIDES =. "imx93-11x11-lpddr4x-evk:"
require conf/machine/imx93-11x11-lpddr4x-evk.conf

MACHINE_FEATURES:append = " matteradvanced "

DELTA_KERNEL_DEFCONFIG="${WORKDIR}/WCS-kernel-config/*"
# Include device trees for other boards for internal test
KERNEL_DEVICETREE += " \
        freescale/imx93-11x11-evk-ffu_gpio_irq.dtb \
        freescale/imx93-14x14-evk.dtb \
        freescale/imx93-14x14-evk-rm67199.dtb \
        freescale/imx93-9x9-qsb.dtb \
        freescale/imx93-9x9-qsb-can1.dtb \
        freescale/imx93-9x9-qsb-flexspi-m2.dtb \
        freescale/imx93-9x9-qsb-i3c.dtb \
        freescale/imx93-9x9-qsb-lpspi.dtb \
        freescale/imx93-9x9-qsb-lpspi-slave.dtb \
        freescale/imx93-9x9-qsb-mt9m114.dtb \
        freescale/imx93-9x9-qsb-ontat-wvga-panel.dtb \
"
DTS_FILE="${BSPDIR}/sources/meta-matter/recipes-kernel/linux/files/imx93-11x11-evk-ffu_gpio_irq.dts"

UBOOT_DELTA_CONFIG="${WORKDIR}/WCS-uboot-config/*"
```

## meta-nxp-matter-advanced/conf/machine/imx93evk-matter.conf
```bitbake
#@TYPE: Machine
#@NAME: i.MX 93 EVK Matter
#@SOC: i.MX93
#@DESCRIPTION: Machine configuration for NXP i.MX 93 Evaluation Kit for Matter
#@MAINTAINER: Elven Wang <elven.wang@nxp.com>

MACHINEOVERRIDES =. "imx93-11x11-lpddr4x-evk:"
require conf/machine/imx93-11x11-lpddr4x-evk.conf
require conf/multilib.conf
MULTILIBS = "multilib:lib32"
DEFAULTTUNE:virtclass-multilib-lib32 = "armv7athf-neon"

MACHINE_FEATURES:append = " matteradvanced "

KERNEL_DEVICETREE += " \
        freescale/imx93-11x11-evk-iw612-otbr.dtb \
        freescale/imx93-14x14-evk.dtb \
        freescale/imx93-14x14-evk-rm67199.dtb \
        freescale/imx93-9x9-qsb.dtb \
        freescale/imx93-9x9-qsb-can1.dtb \
        freescale/imx93-9x9-qsb-flexspi-m2.dtb \
        freescale/imx93-9x9-qsb-i3c.dtb \
        freescale/imx93-9x9-qsb-lpspi.dtb \
        freescale/imx93-9x9-qsb-lpspi-slave.dtb \
        freescale/imx93-9x9-qsb-mt9m114.dtb \
        freescale/imx93-9x9-qsb-ontat-wvga-panel.dtb \
"
```

## meta-nxp-matter-baseline/conf/layer.conf
```bitbake
BBPATH .= ":${LAYERDIR}"

BBFILES += "${LAYERDIR}/recipes-*/*/*.bb \
            ${LAYERDIR}/recipes-*/*/*.bbappend"

LAYERSERIES_COMPAT_nxp-matter-baseline = "kirkstone mickledore nanbield scarthgap"

BBFILE_COLLECTIONS += "nxp-matter-baseline"
BBFILE_PATTERN_nxp-matter-baseline = "^${LAYERDIR}/"
BBFILE_PRIORITY_nxp-matter-baseline = "7"
```

## meta-nxp-matter/meta-nxp-matter-advanced/conf/layer.conf
```bitbake
BBPATH .= ":${LAYERDIR}"

BBFILES += "${LAYERDIR}/recipes-*/*/*.bb \
            ${LAYERDIR}/recipes-*/*/*.bbappend"

LAYERSERIES_COMPAT_meta-matter = "mickledore nanbield scarthgap"

IMAGE_INSTALL:append = " ${@bb.utils.contains('MACHINE_FEATURES', 'trusty', 'storageproxyd', '', d)} "
```

## meta-nxp-matter/meta-nxp-matter-baseline/conf/layer.conf
```bitbake
BBPATH .= ":${LAYERDIR}"

BBFILES += "${LAYERDIR}/recipes-*/*/*.bb \
            ${LAYERDIR}/recipes-*/*/*.bbappend"

LAYERSERIES_COMPAT_meta-nxp-matter-baseline = "mickledore nanbield scarthgap"

IMAGE_INSTALL:append = " matter dcldownloader "

BBFILE_COLLECTIONS += "meta-nxp-matter-baseline"
BBFILE_PATTERN_meta-nxp-matter-baseline = "^${LAYERDIR}/"
BBFILE_PRIORITY_meta-nxp-matter-baseline = "7"
```

## meta-nxp-openthread/conf/layer.conf
```bitbake
BBPATH .= ":${LAYERDIR}"

BBFILES += "${LAYERDIR}/recipes-*/*.bb \
            ${LAYERDIR}/recipes-*/*/*.bb \
            ${LAYERDIR}/recipes-*/*/*.bbappend"

LAYERSERIES_COMPAT_nxp-openthread = "styhead walnascar whinlatter "

BBFILE_COLLECTIONS += "nxp-openthread"
BBFILE_PATTERN_nxp-openthread = "^${LAYERDIR}/"
BBFILE_PRIORITY_nxp-openthread = "7"
```

## meta-nxp-otbr/conf/layer.conf
```bitbake
BBPATH .= ":${LAYERDIR}"

BBFILES += "${LAYERDIR}/recipes-*/*.bb \
            ${LAYERDIR}/recipes-*/*/*.bb \
            ${LAYERDIR}/recipes-*/*/*.bbappend"

LAYERSERIES_COMPAT_nxp-otbr = "kirkstone mickledore nanbield scarthgap"

BBFILE_COLLECTIONS += "nxp-otbr"
BBFILE_PATTERN_nxp-otbr = "^${LAYERDIR}/"
BBFILE_PRIORITY_nxp-otbr = "7"

TOOLCHAIN_HOST_TASK:append = " nativesdk-protobuf-compiler"
PACKAGECONFIG:append:pn-iptables = " libnftnl"
DELTA_KERNEL_DEFCONFIG="${WORKDIR}/kernel-config/*"
```

## meta-nxp-zigbee-rcp/conf/layer.conf
```bitbake
BBPATH .= ":${LAYERDIR}"

BBFILES += "${LAYERDIR}/*.bb \
            ${LAYERDIR}/recipes-*/*/*.bb \
            ${LAYERDIR}/recipes-*/*/*.bbappend"

LAYERSERIES_COMPAT_nxp-zigbee-rcp = "scarthgap"

BBFILE_COLLECTIONS += "nxp-zigbee-rcp"
BBFILE_PATTERN_nxp-zigbee-rcp = "^${LAYERDIR}/"
BBFILE_PRIORITY_nxp-zigbee-rcp = "7"
```
