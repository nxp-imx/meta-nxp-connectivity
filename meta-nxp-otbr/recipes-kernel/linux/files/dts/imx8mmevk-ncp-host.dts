#include "imx8mm-evk.dts"

&micfil {
	status = "disabled";
};

&ecspi2 {
	pinctrl-names = "default";
	pinctrl-0 = <&pinctrl_ecspi2 &pinctrl_ecspi2_cs &pinctrl_gpio_ncp>;
};

&iomuxc {
pinctrl_gpio_ncp: gpio_ncp {
	fsl.pins = <
		MX8MM_IOMUXC_SAI5_RXD0_GPIO3_IO21      0x1d9
		MX8MM_IOMUXC_SAI5_RXD1_GPIO3_IO22      0x1d9
		MX8MM_IOMUXC_SAI5_RXD2_GPIO3_IO23      0x1d9
		MX8MM_IOMUXC_SAI5_RXD3_GPIO3_IO24      0x1d9
		>;
	};
};
